## telefonillo_inteligente/components/cliente_mqtt/Kconfig.projbuild
```kconfig
menu "MQTT Broker Configuration"

    config BROKER_URL
        string "Broker URL"
        default ""
        help
            URL of the broker to connect to
    
    config BROKER_PORT
        int "Broker PORT"
        default 1883
        range 1 65535
        help
            Port of the broker to connect to

    config ALARM_TOPIC
        string "Alarm Topic"
        default "Telefonillos/FaceDetectedAlarm"
        help
            Topic to publish alarm messages to
    

endmenu
```

## telefonillo_inteligente/main/Kconfig.projbuild
```kconfig
menu "Telefonillo ID Configuration"

    config DEVICE_NAME
        string "Device Name"
        default "Telefonillo1"
        help
            Name or ID of the device.

endmenu
```
